
; PICBASIC PRO(TM) Compiler 3.0.9.2, (c) 1998, 2016 microEngineering Labs, Inc. All Rights Reserved. 
MPASMX_USED			EQU	1

#define	PBP_PATH	C:\PROGRAM FILES (X86)\PBP3\




        NOLIST
    ifdef PM_USED
        LIST
        include 'M16F88.INC'	; PM header
        XALL
        NOLIST
    else
        LIST
        LIST p = 16F88, r = dec, w = -302, c = 255
        INCLUDE "P16F88.INC"	; MPASM  Header
        NOLIST
    endif
        LIST


PBP_HARDWAREDEF  macro
  endm


    __CONFIG _CONFIG1, _INTRC_IO & _PWRTE_ON & _MCLR_OFF & _LVP_OFF



; Define statements.
; C:\PROGRAM FILES (X86)\PBP3\DEVICES\PIC16F88.PBPINC	00144	DEFINE  CODE_SIZE 4
#define		CODE_SIZE		 4
; U:\MECH 307 CODE\MECH307L10.PBP	00027	DEFINE OSC 8
#define		OSC		 8

RAM_START       		EQU	00020h
RAM_END         		EQU	001EFh
RAM_BANKS       		EQU	00004h
BANK0_START     		EQU	00020h
BANK0_END       		EQU	0007Fh
BANK1_START     		EQU	000A0h
BANK1_END       		EQU	000EFh
BANK2_START     		EQU	00110h
BANK2_END       		EQU	0016Fh
BANK3_START     		EQU	00190h
BANK3_END       		EQU	001EFh
EEPROM_START    		EQU	02100h
EEPROM_END      		EQU	021FFh

; C:\PROGRAM FILES (X86)\PBP3\PBPPIC14.RAM	00012	A00020	R0      VAR     WORD BANK0 SYSTEM       ' System Register
R0              		EQU	RAM_START + 000h
; C:\PROGRAM FILES (X86)\PBP3\PBPPIC14.RAM	00013	A00022	R1      VAR     WORD BANK0 SYSTEM       ' System Register
R1              		EQU	RAM_START + 002h
; C:\PROGRAM FILES (X86)\PBP3\PBPPIC14.RAM	00014	A00024	R2      VAR     WORD BANK0 SYSTEM       ' System Register
R2              		EQU	RAM_START + 004h
; C:\PROGRAM FILES (X86)\PBP3\PBPPIC14.RAM	00015	A00026	R3      VAR     WORD BANK0 SYSTEM       ' System Register
R3              		EQU	RAM_START + 006h
; C:\PROGRAM FILES (X86)\PBP3\PBPPIC14.RAM	00016	A00028	R4      VAR     WORD BANK0 SYSTEM       ' System Register
R4              		EQU	RAM_START + 008h
; C:\PROGRAM FILES (X86)\PBP3\PBPPIC14.RAM	00017	A0002A	R5      VAR     WORD BANK0 SYSTEM       ' System Register
R5              		EQU	RAM_START + 00Ah
; C:\PROGRAM FILES (X86)\PBP3\PBPPIC14.RAM	00018	A0002C	R6      VAR     WORD BANK0 SYSTEM       ' System Register
R6              		EQU	RAM_START + 00Ch
; C:\PROGRAM FILES (X86)\PBP3\PBPPIC14.RAM	00019	A0002E	R7      VAR     WORD BANK0 SYSTEM       ' System Register
R7              		EQU	RAM_START + 00Eh
; C:\PROGRAM FILES (X86)\PBP3\PBPPIC14.RAM	00020	A00030	R8      VAR     WORD BANK0 SYSTEM       ' System Register
R8              		EQU	RAM_START + 010h
; C:\PROGRAM FILES (X86)\PBP3\PBPPIC14.RAM	00026	A00032	FLAGS   VAR     BYTE BANK0 SYSTEM       ' Static flags
FLAGS           		EQU	RAM_START + 012h
; C:\PROGRAM FILES (X86)\PBP3\PBPPIC14.RAM	00025	A00033	GOP     VAR     BYTE BANK0 SYSTEM       ' Gen Op Parameter
GOP             		EQU	RAM_START + 013h
; C:\PROGRAM FILES (X86)\PBP3\PBPPIC14.RAM	00022	A00034	RM1     VAR     BYTE BANK0 SYSTEM       ' Pin 1 Mask
RM1             		EQU	RAM_START + 014h
; C:\PROGRAM FILES (X86)\PBP3\PBPPIC14.RAM	00024	A00035	RM2     VAR     BYTE BANK0 SYSTEM       ' Pin 2 Mask
RM2             		EQU	RAM_START + 015h
; C:\PROGRAM FILES (X86)\PBP3\PBPPIC14.RAM	00021	A00036	RR1     VAR     BYTE BANK0 SYSTEM       ' Pin 1 Register
RR1             		EQU	RAM_START + 016h
; C:\PROGRAM FILES (X86)\PBP3\PBPPIC14.RAM	00023	A00037	RR2     VAR     BYTE BANK0 SYSTEM       ' Pin 2 Register
RR2             		EQU	RAM_START + 017h
; U:\MECH 307 CODE\MECH307L10.PBP	00038	A00038	pins var byte[16] 'current pins
_pins            		EQU	RAM_START + 018h
; U:\MECH 307 CODE\MECH307L10.PBP	00001	A00048	' PIC16F88 code template for MECH307 Labs
T1              		EQU	RAM_START + 028h
; U:\MECH 307 CODE\MECH307L10.PBP	00039	A0004A	I var byte 'counter
_I               		EQU	RAM_START + 02Ah
; C:\PROGRAM FILES (X86)\PBP3\DEVICES\PIC16F88.PBPINC	00145	PORTL   VAR     PORTB
_PORTL           		EQU	 PORTB
; C:\PROGRAM FILES (X86)\PBP3\DEVICES\PIC16F88.PBPINC	00146	PORTH   VAR     PORTA
_PORTH           		EQU	 PORTA
; C:\PROGRAM FILES (X86)\PBP3\DEVICES\PIC16F88.PBPINC	00147	TRISL   VAR     TRISB
_TRISL           		EQU	 TRISB
; C:\PROGRAM FILES (X86)\PBP3\DEVICES\PIC16F88.PBPINC	00148	TRISH   VAR     TRISA
_TRISH           		EQU	 TRISA
#define _OSCCON??4       	 OSCCON, 004h
#define _OSCCON??5       	 OSCCON, 005h
#define _OSCCON??6       	 OSCCON, 006h
#define _PORTA??1        	 PORTA, 001h
#define _PORTA??2        	 PORTA, 002h
#define _PORTA??3        	 PORTA, 003h
	INCLUDE	"MECH307L10.MAC"
	INCLUDE	"C:\PROGRAM FILES (X86)\PBP3\PBPPIC14.LIB"


; C:\PROGRAM FILES (X86)\PBP3\DEVICES\PIC16F88.PBPINC	00036	#HEADER
; C:\PROGRAM FILES (X86)\PBP3\DEVICES\PIC16F88.PBPINC	00060	#CONFIG
; C:\PROGRAM FILES (X86)\PBP3\DEVICES\PIC16F88.PBPINC	00134	BANK0   $0020, $007F
; C:\PROGRAM FILES (X86)\PBP3\DEVICES\PIC16F88.PBPINC	00135	BANK1   $00A0, $00EF
; C:\PROGRAM FILES (X86)\PBP3\DEVICES\PIC16F88.PBPINC	00136	BANK2   $0110, $016F
; C:\PROGRAM FILES (X86)\PBP3\DEVICES\PIC16F88.PBPINC	00137	BANK3   $0190, $01EF
; C:\PROGRAM FILES (X86)\PBP3\DEVICES\PIC16F88.PBPINC	00139	EEPROM  $2100, $21FF
; C:\PROGRAM FILES (X86)\PBP3\DEVICES\PIC16F88.PBPINC	00141	    #ERROR "-n option (PBPL) is not supported for this device."
; C:\PROGRAM FILES (X86)\PBP3\DEVICES\PIC16F88.PBPINC	00142	#ENDIF
; C:\PROGRAM FILES (X86)\PBP3\DEVICES\PIC16F88.PBPINC	00143	LIBRARY "PBPPIC14"
; C:\PROGRAM FILES (X86)\PBP3\DEVICES\PIC16F88.PBPINC	00144	DEFINE  CODE_SIZE 4

; C:\PROGRAM FILES (X86)\PBP3\DEVICES\PIC16F88.PBPINC	00149	include "PBPPIC14.RAM"
; C:\PROGRAM FILES (X86)\PBP3\DEVICES\PIC16F88.PBPINC	00153	#HEADER
; U:\MECH 307 CODE\MECH307L10.PBP	00022	#CONFIG
; U:\MECH 307 CODE\MECH307L10.PBP	00027	DEFINE OSC 8

; U:\MECH 307 CODE\MECH307L10.PBP	00028	OSCCON.4 = 1
	MOVE?CT	001h, _OSCCON??4

; U:\MECH 307 CODE\MECH307L10.PBP	00029	OSCCON.5 = 1
	MOVE?CT	001h, _OSCCON??5

; U:\MECH 307 CODE\MECH307L10.PBP	00030	OSCCON.6 = 1
	MOVE?CT	001h, _OSCCON??6

; U:\MECH 307 CODE\MECH307L10.PBP	00034	ansel = 0
	MOVE?CB	000h, ANSEL

; U:\MECH 307 CODE\MECH307L10.PBP	00040	TRISA = %00001110 ' A1,2,3, are inputs
	MOVE?CB	00Eh, TRISA

; U:\MECH 307 CODE\MECH307L10.PBP	00041	TRISB = %00000000
	MOVE?CB	000h, TRISB

; U:\MECH 307 CODE\MECH307L10.PBP	00043	pins[ 0] = %00000010
	MOVE?CB	002h, _pins

; U:\MECH 307 CODE\MECH307L10.PBP	00044	pins[ 1] = %00110111
	MOVE?CB	037h, _pins + 00001h

; U:\MECH 307 CODE\MECH307L10.PBP	00045	pins[ 2] = %01000001
	MOVE?CB	041h, _pins + 00002h

; U:\MECH 307 CODE\MECH307L10.PBP	00046	pins[ 3] = %00010001
	MOVE?CB	011h, _pins + 00003h

; U:\MECH 307 CODE\MECH307L10.PBP	00047	pins[ 4] = %00110100
	MOVE?CB	034h, _pins + 00004h

; U:\MECH 307 CODE\MECH307L10.PBP	00048	pins[ 5] = %00011000
	MOVE?CB	018h, _pins + 00005h

; U:\MECH 307 CODE\MECH307L10.PBP	00049	pins[ 6] = %00001000
	MOVE?CB	008h, _pins + 00006h

; U:\MECH 307 CODE\MECH307L10.PBP	00050	pins[ 7] = %00110011
	MOVE?CB	033h, _pins + 00007h

; U:\MECH 307 CODE\MECH307L10.PBP	00051	pins[ 8] = %00000000
	MOVE?CB	000h, _pins + 00008h

; U:\MECH 307 CODE\MECH307L10.PBP	00052	pins[ 9] = %00110000
	MOVE?CB	030h, _pins + 00009h

; U:\MECH 307 CODE\MECH307L10.PBP	00053	pins[10] = %00100000'%00100000
	MOVE?CB	020h, _pins + 0000Ah

; U:\MECH 307 CODE\MECH307L10.PBP	00054	pins[11] = %00001100
	MOVE?CB	00Ch, _pins + 0000Bh

; U:\MECH 307 CODE\MECH307L10.PBP	00055	pins[12] = %01001010
	MOVE?CB	04Ah, _pins + 0000Ch

; U:\MECH 307 CODE\MECH307L10.PBP	00056	pins[13] = %00000101
	MOVE?CB	005h, _pins + 0000Dh

; U:\MECH 307 CODE\MECH307L10.PBP	00057	pins[14] = %01001000
	MOVE?CB	048h, _pins + 0000Eh

; U:\MECH 307 CODE\MECH307L10.PBP	00058	pins[15] = %01101000
	MOVE?CB	068h, _pins + 0000Fh

; U:\MECH 307 CODE\MECH307L10.PBP	00061	I=0
	MOVE?CB	000h, _I

; U:\MECH 307 CODE\MECH307L10.PBP	00062	Gosub Updatepins
	GOSUB?L	_Updatepins

; U:\MECH 307 CODE\MECH307L10.PBP	00064	myloop:

	LABEL?L	_myloop	

; U:\MECH 307 CODE\MECH307L10.PBP	00066	    if(PORTA.1==0) then
	CMPNE?TCL	_PORTA??1, 000h, L00001

; U:\MECH 307 CODE\MECH307L10.PBP	00067	        I=0
	MOVE?CB	000h, _I

; U:\MECH 307 CODE\MECH307L10.PBP	00068	        Gosub Updatepins
	GOSUB?L	_Updatepins

; U:\MECH 307 CODE\MECH307L10.PBP	00069	        Pause 100 
	PAUSE?C	064h

; U:\MECH 307 CODE\MECH307L10.PBP	00070	    endif
	LABEL?L	L00001	

; U:\MECH 307 CODE\MECH307L10.PBP	00073	    do while(PORTA.2==0)
	LABEL?L	L00003	
	CMPNE?TCL	_PORTA??2, 000h, L00004

; U:\MECH 307 CODE\MECH307L10.PBP	00074	        if(I==15) then           
	CMPNE?BCL	_I, 00Fh, L00005

; U:\MECH 307 CODE\MECH307L10.PBP	00075	            I=0
	MOVE?CB	000h, _I

; U:\MECH 307 CODE\MECH307L10.PBP	00076	        Else
	GOTO?L	L00006
	LABEL?L	L00005	

; U:\MECH 307 CODE\MECH307L10.PBP	00077	            I=I+1
	ADD?BCB	_I, 001h, _I

; U:\MECH 307 CODE\MECH307L10.PBP	00078	        endif
	LABEL?L	L00006	

; U:\MECH 307 CODE\MECH307L10.PBP	00080	        Gosub Updatepins
	GOSUB?L	_Updatepins

; U:\MECH 307 CODE\MECH307L10.PBP	00081	        Pause 200
	PAUSE?C	0C8h

; U:\MECH 307 CODE\MECH307L10.PBP	00082	    loop
	GOTO?L	L00003
	LABEL?L	L00004	

; U:\MECH 307 CODE\MECH307L10.PBP	00085	    do while(PORTA.3==0)
	LABEL?L	L00007	
	CMPNE?TCL	_PORTA??3, 000h, L00008

; U:\MECH 307 CODE\MECH307L10.PBP	00086	        if(I==0) then           
	CMPNE?BCL	_I, 000h, L00009

; U:\MECH 307 CODE\MECH307L10.PBP	00087	            I=15
	MOVE?CB	00Fh, _I

; U:\MECH 307 CODE\MECH307L10.PBP	00088	        Else
	GOTO?L	L00010
	LABEL?L	L00009	

; U:\MECH 307 CODE\MECH307L10.PBP	00089	            I=I-1
	SUB?BCB	_I, 001h, _I

; U:\MECH 307 CODE\MECH307L10.PBP	00090	        endif
	LABEL?L	L00010	

; U:\MECH 307 CODE\MECH307L10.PBP	00092	        Gosub Updatepins
	GOSUB?L	_Updatepins

; U:\MECH 307 CODE\MECH307L10.PBP	00093	        Pause 200
	PAUSE?C	0C8h

; U:\MECH 307 CODE\MECH307L10.PBP	00094	    loop
	GOTO?L	L00007
	LABEL?L	L00008	

; U:\MECH 307 CODE\MECH307L10.PBP	00096	goto myloop
	GOTO?L	_myloop

; U:\MECH 307 CODE\MECH307L10.PBP	00098	Updatepins:

	LABEL?L	_Updatepins	

; U:\MECH 307 CODE\MECH307L10.PBP	00099	    PORTB = pins[I]
	AOUT?BBB	_pins, _I, PORTB

; U:\MECH 307 CODE\MECH307L10.PBP	00100	    return
	RETURN?	

	END
