
; PICBASIC PRO(TM) Compiler 3.0.9.2, (c) 1998, 2016 microEngineering Labs, Inc. All Rights Reserved. 
MPASMX_USED			EQU	1

#define	PBP_PATH	C:\PROGRAM FILES (X86)\PBP3\




        NOLIST
    ifdef PM_USED
        LIST
        include 'M16F88.INC'	; PM header
        XALL
        NOLIST
    else
        LIST
        LIST p = 16F88, r = dec, w = -302, c = 255
        INCLUDE "P16F88.INC"	; MPASM  Header
        NOLIST
    endif
        LIST


PBP_HARDWAREDEF  macro
  endm


    __CONFIG _CONFIG1, _INTRC_IO & _PWRTE_ON & _MCLR_OFF & _LVP_OFF



; Define statements.
; C:\PROGRAM FILES (X86)\PBP3\DEVICES\PIC16F88.PBPINC	00144	DEFINE  CODE_SIZE 4
#define		CODE_SIZE		 4
; U:\MECH 307 CODE\LAB11PWM.BAS	00008	Define OSC 8
#define		OSC		 8

RAM_START       		EQU	00020h
RAM_END         		EQU	001EFh
RAM_BANKS       		EQU	00004h
BANK0_START     		EQU	00020h
BANK0_END       		EQU	0007Fh
BANK1_START     		EQU	000A0h
BANK1_END       		EQU	000EFh
BANK2_START     		EQU	00110h
BANK2_END       		EQU	0016Fh
BANK3_START     		EQU	00190h
BANK3_END       		EQU	001EFh
EEPROM_START    		EQU	02100h
EEPROM_END      		EQU	021FFh

; C:\PROGRAM FILES (X86)\PBP3\PBPPIC14.RAM	00012	A00020	R0      VAR     WORD BANK0 SYSTEM       ' System Register
R0              		EQU	RAM_START + 000h
; C:\PROGRAM FILES (X86)\PBP3\PBPPIC14.RAM	00013	A00022	R1      VAR     WORD BANK0 SYSTEM       ' System Register
R1              		EQU	RAM_START + 002h
; C:\PROGRAM FILES (X86)\PBP3\PBPPIC14.RAM	00014	A00024	R2      VAR     WORD BANK0 SYSTEM       ' System Register
R2              		EQU	RAM_START + 004h
; C:\PROGRAM FILES (X86)\PBP3\PBPPIC14.RAM	00015	A00026	R3      VAR     WORD BANK0 SYSTEM       ' System Register
R3              		EQU	RAM_START + 006h
; C:\PROGRAM FILES (X86)\PBP3\PBPPIC14.RAM	00016	A00028	R4      VAR     WORD BANK0 SYSTEM       ' System Register
R4              		EQU	RAM_START + 008h
; C:\PROGRAM FILES (X86)\PBP3\PBPPIC14.RAM	00017	A0002A	R5      VAR     WORD BANK0 SYSTEM       ' System Register
R5              		EQU	RAM_START + 00Ah
; C:\PROGRAM FILES (X86)\PBP3\PBPPIC14.RAM	00018	A0002C	R6      VAR     WORD BANK0 SYSTEM       ' System Register
R6              		EQU	RAM_START + 00Ch
; C:\PROGRAM FILES (X86)\PBP3\PBPPIC14.RAM	00019	A0002E	R7      VAR     WORD BANK0 SYSTEM       ' System Register
R7              		EQU	RAM_START + 00Eh
; C:\PROGRAM FILES (X86)\PBP3\PBPPIC14.RAM	00020	A00030	R8      VAR     WORD BANK0 SYSTEM       ' System Register
R8              		EQU	RAM_START + 010h
; C:\PROGRAM FILES (X86)\PBP3\PBPPIC14.RAM	00026	A00032	FLAGS   VAR     BYTE BANK0 SYSTEM       ' Static flags
FLAGS           		EQU	RAM_START + 012h
; C:\PROGRAM FILES (X86)\PBP3\PBPPIC14.RAM	00025	A00033	GOP     VAR     BYTE BANK0 SYSTEM       ' Gen Op Parameter
GOP             		EQU	RAM_START + 013h
; C:\PROGRAM FILES (X86)\PBP3\PBPPIC14.RAM	00022	A00034	RM1     VAR     BYTE BANK0 SYSTEM       ' Pin 1 Mask
RM1             		EQU	RAM_START + 014h
; C:\PROGRAM FILES (X86)\PBP3\PBPPIC14.RAM	00024	A00035	RM2     VAR     BYTE BANK0 SYSTEM       ' Pin 2 Mask
RM2             		EQU	RAM_START + 015h
; C:\PROGRAM FILES (X86)\PBP3\PBPPIC14.RAM	00021	A00036	RR1     VAR     BYTE BANK0 SYSTEM       ' Pin 1 Register
RR1             		EQU	RAM_START + 016h
; C:\PROGRAM FILES (X86)\PBP3\PBPPIC14.RAM	00023	A00037	RR2     VAR     BYTE BANK0 SYSTEM       ' Pin 2 Register
RR2             		EQU	RAM_START + 017h
; U:\MECH 307 CODE\LAB11PWM.BAS	00028	A00038	T		Var	Word		'Pulse Period in milliseconds
_T               		EQU	RAM_START + 018h
; U:\MECH 307 CODE\LAB11PWM.BAS	00001	A0003A	'pwm.bas
T1              		EQU	RAM_START + 01Ah
; U:\MECH 307 CODE\LAB11PWM.BAS	00001	A0003C	'pwm.bas
T2              		EQU	RAM_START + 01Ch
; U:\MECH 307 CODE\LAB11PWM.BAS	00001	A0003E	'pwm.bas
T3              		EQU	RAM_START + 01Eh
; U:\MECH 307 CODE\LAB11PWM.BAS	00029	A00040	t_on		Var	Word		'Pulse width high state
_t_on            		EQU	RAM_START + 020h
; U:\MECH 307 CODE\LAB11PWM.BAS	00030	A00042	T_t		Var 	Word		'Pulse down (low state) time:(T-t)
_T_t             		EQU	RAM_START + 022h
; U:\MECH 307 CODE\LAB11PWM.BAS	00034	A00044	pot_val		Var	BYTE		'Value returned by POT command
_pot_val         		EQU	RAM_START + 024h
; U:\MECH 307 CODE\LAB11PWM.BAS	00026	A00045	speed		Var	BYTE		'user input speed
_speed           		EQU	RAM_START + 025h
; C:\PROGRAM FILES (X86)\PBP3\DEVICES\PIC16F88.PBPINC	00145	PORTL   VAR     PORTB
_PORTL           		EQU	 PORTB
; C:\PROGRAM FILES (X86)\PBP3\DEVICES\PIC16F88.PBPINC	00146	PORTH   VAR     PORTA
_PORTH           		EQU	 PORTA
; C:\PROGRAM FILES (X86)\PBP3\DEVICES\PIC16F88.PBPINC	00147	TRISL   VAR     TRISB
_TRISL           		EQU	 TRISB
; C:\PROGRAM FILES (X86)\PBP3\DEVICES\PIC16F88.PBPINC	00148	TRISH   VAR     TRISA
_TRISH           		EQU	 TRISA
#define _led0            	_PORTB??0
#define _led1            	_PORTB??1
#define _led2            	_PORTB??2
#define _led3            	_PORTB??3
#define _motor           	_PORTA??1
#define _change          	_PORTA??3
#define _pot_pin         	_PORTA??2
#define _OSCCON??4       	 OSCCON, 004h
#define _OSCCON??5       	 OSCCON, 005h
#define _OSCCON??6       	 OSCCON, 006h
#define _PORTB??0        	 PORTB, 000h
#define _PORTB??1        	 PORTB, 001h
#define _PORTB??2        	 PORTB, 002h
#define _PORTB??3        	 PORTB, 003h
#define _PORTA??1        	 PORTA, 001h
#define _PORTA??3        	 PORTA, 003h
#define _PORTA??2        	 PORTA, 002h

; Constants.
_Max_Speed       		EQU	0000Fh
_SCALE           		EQU	000FFh
	INCLUDE	"LAB11PWM.MAC"
	INCLUDE	"C:\PROGRAM FILES (X86)\PBP3\PBPPIC14.LIB"


; C:\PROGRAM FILES (X86)\PBP3\DEVICES\PIC16F88.PBPINC	00036	#HEADER
; C:\PROGRAM FILES (X86)\PBP3\DEVICES\PIC16F88.PBPINC	00060	#CONFIG
; C:\PROGRAM FILES (X86)\PBP3\DEVICES\PIC16F88.PBPINC	00134	BANK0   $0020, $007F
; C:\PROGRAM FILES (X86)\PBP3\DEVICES\PIC16F88.PBPINC	00135	BANK1   $00A0, $00EF
; C:\PROGRAM FILES (X86)\PBP3\DEVICES\PIC16F88.PBPINC	00136	BANK2   $0110, $016F
; C:\PROGRAM FILES (X86)\PBP3\DEVICES\PIC16F88.PBPINC	00137	BANK3   $0190, $01EF
; C:\PROGRAM FILES (X86)\PBP3\DEVICES\PIC16F88.PBPINC	00139	EEPROM  $2100, $21FF
; C:\PROGRAM FILES (X86)\PBP3\DEVICES\PIC16F88.PBPINC	00141	    #ERROR "-n option (PBPL) is not supported for this device."
; C:\PROGRAM FILES (X86)\PBP3\DEVICES\PIC16F88.PBPINC	00142	#ENDIF
; C:\PROGRAM FILES (X86)\PBP3\DEVICES\PIC16F88.PBPINC	00143	LIBRARY "PBPPIC14"
; C:\PROGRAM FILES (X86)\PBP3\DEVICES\PIC16F88.PBPINC	00144	DEFINE  CODE_SIZE 4

; C:\PROGRAM FILES (X86)\PBP3\DEVICES\PIC16F88.PBPINC	00149	include "PBPPIC14.RAM"
; C:\PROGRAM FILES (X86)\PBP3\DEVICES\PIC16F88.PBPINC	00153	#HEADER
; U:\MECH 307 CODE\LAB11PWM.BAS	00003	#CONFIG
; U:\MECH 307 CODE\LAB11PWM.BAS	00008	Define OSC 8

; U:\MECH 307 CODE\LAB11PWM.BAS	00009	OSCCON.4=1
	MOVE?CT	001h, _OSCCON??4

; U:\MECH 307 CODE\LAB11PWM.BAS	00010	OSCCON.5=1
	MOVE?CT	001h, _OSCCON??5

; U:\MECH 307 CODE\LAB11PWM.BAS	00011	OSCCON.6=1
	MOVE?CT	001h, _OSCCON??6

; U:\MECH 307 CODE\LAB11PWM.BAS	00014	ANSEL=0
	MOVE?CB	000h, ANSEL
; U:\MECH 307 CODE\LAB11PWM.BAS	00027	Max_Speed	Con	15		'Max relative speed
; U:\MECH 307 CODE\LAB11PWM.BAS	00033	SCALE		Con	255		'POT statement scale factor

; U:\MECH 307 CODE\LAB11PWM.BAS	00037	TRISA=%11101				'Designate PORTA Pins as inputs and output (RA1)
	MOVE?CB	01Dh, TRISA

; U:\MECH 307 CODE\LAB11PWM.BAS	00038	TRISB=%00000000				'Designate PORTB Pins as outputs
	MOVE?CB	000h, TRISB

; U:\MECH 307 CODE\LAB11PWM.BAS	00039	PORTB=0
	MOVE?CB	000h, PORTB

; U:\MECH 307 CODE\LAB11PWM.BAS	00041	Low motor				'make motor off indefinetely
	LOW?T	_motor

; U:\MECH 307 CODE\LAB11PWM.BAS	00043	T=30000					'Pulse period microseconds
	MOVE?CW	07530h, _T

; U:\MECH 307 CODE\LAB11PWM.BAS	00044	speed=7					'select medium speed
	MOVE?CB	007h, _speed

; U:\MECH 307 CODE\LAB11PWM.BAS	00045	PORTB=speed				'display speed as binary number on LED's
	MOVE?BB	_speed, PORTB

; U:\MECH 307 CODE\LAB11PWM.BAS	00047	top:

	LABEL?L	_top	

; U:\MECH 307 CODE\LAB11PWM.BAS	00048	gosub myloop
	GOSUB?L	_myloop

; U:\MECH 307 CODE\LAB11PWM.BAS	00049	goto new 
	GOTO?L	_new

; U:\MECH 307 CODE\LAB11PWM.BAS	00051	myloop:

	LABEL?L	_myloop	

; U:\MECH 307 CODE\LAB11PWM.BAS	00054		Do While(1) 			'1:true
	LABEL?L	L00001	
	CMPF?CL	001h, L00002

; U:\MECH 307 CODE\LAB11PWM.BAS	00056	      	     POT pot_pin,SCALE,pot_val	'Read the keypad resistance
	POT?TCB	_pot_pin, _SCALE, _pot_val

; U:\MECH 307 CODE\LAB11PWM.BAS	00059	    		If((pot_val>37) && (pot_val<114) &&(speed<Max_Speed)) Then
	CMPGT?BCB	_pot_val, 025h, T1
	CMPLT?BCB	_pot_val, 072h, T2
	LAND?BBW	T1, T2, T2
	CMPLT?BCB	_speed, _Max_Speed, T3
	LAND?WBW	T2, T3, T3
	CMPF?WL	T3, L00003

; U:\MECH 307 CODE\LAB11PWM.BAS	00060	    		speed=speed+1
	ADD?BCB	_speed, 001h, _speed

; U:\MECH 307 CODE\LAB11PWM.BAS	00061	    		PORTB=speed
	MOVE?BB	_speed, PORTB

; U:\MECH 307 CODE\LAB11PWM.BAS	00062	    		Pause 300
	PAUSE?C	0012Ch

; U:\MECH 307 CODE\LAB11PWM.BAS	00065	    		ElseIf((pot_val>114) && (pot_val<192) && (speed>0)) Then
	GOTO?L	L00004
	LABEL?L	L00003	
	CMPGT?BCB	_pot_val, 072h, T1
	CMPLT?BCB	_pot_val, 0C0h, T2
	LAND?BBW	T1, T2, T2
	CMPGT?BCB	_speed, 000h, T3
	LAND?WBW	T2, T3, T3
	CMPF?WL	T3, L00005

; U:\MECH 307 CODE\LAB11PWM.BAS	00066	        		speed=speed-1
	SUB?BCB	_speed, 001h, _speed

; U:\MECH 307 CODE\LAB11PWM.BAS	00067	        		PORTB=speed
	MOVE?BB	_speed, PORTB

; U:\MECH 307 CODE\LAB11PWM.BAS	00068	                Pause 300
	PAUSE?C	0012Ch

; U:\MECH 307 CODE\LAB11PWM.BAS	00070	    		ElseIf(pot_val>192) Then
	GOTO?L	L00004
	LABEL?L	L00005	
	CMPLE?BCL	_pot_val, 0C0h, L00007

; U:\MECH 307 CODE\LAB11PWM.BAS	00071	    		return      
	RETURN?	

; U:\MECH 307 CODE\LAB11PWM.BAS	00073	       		Endif
	LABEL?L	L00004	
	LABEL?L	L00007	

; U:\MECH 307 CODE\LAB11PWM.BAS	00075		Loop
	GOTO?L	L00001
	LABEL?L	L00002	

; U:\MECH 307 CODE\LAB11PWM.BAS	00077	 new:

	LABEL?L	_new	

; U:\MECH 307 CODE\LAB11PWM.BAS	00079	PORTB=0
	MOVE?CB	000h, PORTB

; U:\MECH 307 CODE\LAB11PWM.BAS	00082	t_on = T/5 / max_speed * speed + T/20*3			'Duty Cycle Range= 15% to 35%
	DIV?WCW	_T, 005h, T1
	DIV?WCW	T1, _Max_Speed, T1
	MUL?WBW	T1, _speed, T1
	DIV?WCW	_T, 014h, T2
	MUL?WCW	T2, 003h, T2
	ADD?WWW	T1, T2, _t_on

; U:\MECH 307 CODE\LAB11PWM.BAS	00083	T_t=T-t_on
	SUB?WWW	_T, _t_on, _T_t

; U:\MECH 307 CODE\LAB11PWM.BAS	00086	Do While (change == 0)
	LABEL?L	L00009	
	CMPNE?TCL	_change, 000h, L00010

; U:\MECH 307 CODE\LAB11PWM.BAS	00087		High Motor
	HIGH?T	_motor

; U:\MECH 307 CODE\LAB11PWM.BAS	00088		Pauseus t_on
	PAUSEUS?W	_t_on

; U:\MECH 307 CODE\LAB11PWM.BAS	00089		Low Motor
	LOW?T	_motor

; U:\MECH 307 CODE\LAB11PWM.BAS	00090		Pauseus T_t
	PAUSEUS?W	_T_t

; U:\MECH 307 CODE\LAB11PWM.BAS	00091	Loop
	GOTO?L	L00009
	LABEL?L	L00010	

; U:\MECH 307 CODE\LAB11PWM.BAS	00094	PORTB=speed
	MOVE?BB	_speed, PORTB

; U:\MECH 307 CODE\LAB11PWM.BAS	00096	Goto top
	GOTO?L	_top

; U:\MECH 307 CODE\LAB11PWM.BAS	00098	End		'End never reached
	END?	

	END
