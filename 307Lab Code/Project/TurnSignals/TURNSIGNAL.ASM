
; PICBASIC PRO(TM) Compiler 3.0.9.2, (c) 1998, 2016 microEngineering Labs, Inc. All Rights Reserved. 
MPASMX_USED			EQU	1

#define	PBP_PATH	C:\PROGRAM FILES (X86)\PBP3\




        NOLIST
    ifdef PM_USED
        LIST
        include 'M16F88.INC'	; PM header
        XALL
        NOLIST
    else
        LIST
        LIST p = 16F88, r = dec, w = -302, c = 255
        INCLUDE "P16F88.INC"	; MPASM  Header
        NOLIST
    endif
        LIST


PBP_HARDWAREDEF  macro
  endm


    __CONFIG _CONFIG1, _INTRC_IO & _PWRTE_ON & _MCLR_OFF & _LVP_OFF



; Define statements.
; C:\PROGRAM FILES (X86)\PBP3\DEVICES\PIC16F88.PBPINC	00144	DEFINE  CODE_SIZE 4
#define		CODE_SIZE		 4
; U:\MECH 307 CODE\PROJECT\TURNSIGNALS\TURNSIGNAL.PBP	00005	DEFINE OSC 8
#define		OSC		 8

RAM_START       		EQU	00020h
RAM_END         		EQU	001EFh
RAM_BANKS       		EQU	00004h
BANK0_START     		EQU	00020h
BANK0_END       		EQU	0007Fh
BANK1_START     		EQU	000A0h
BANK1_END       		EQU	000EFh
BANK2_START     		EQU	00110h
BANK2_END       		EQU	0016Fh
BANK3_START     		EQU	00190h
BANK3_END       		EQU	001EFh
EEPROM_START    		EQU	02100h
EEPROM_END      		EQU	021FFh

; C:\PROGRAM FILES (X86)\PBP3\PBPPIC14.RAM	00012	A00020	R0      VAR     WORD BANK0 SYSTEM       ' System Register
R0              		EQU	RAM_START + 000h
; C:\PROGRAM FILES (X86)\PBP3\PBPPIC14.RAM	00013	A00022	R1      VAR     WORD BANK0 SYSTEM       ' System Register
R1              		EQU	RAM_START + 002h
; C:\PROGRAM FILES (X86)\PBP3\PBPPIC14.RAM	00014	A00024	R2      VAR     WORD BANK0 SYSTEM       ' System Register
R2              		EQU	RAM_START + 004h
; C:\PROGRAM FILES (X86)\PBP3\PBPPIC14.RAM	00015	A00026	R3      VAR     WORD BANK0 SYSTEM       ' System Register
R3              		EQU	RAM_START + 006h
; C:\PROGRAM FILES (X86)\PBP3\PBPPIC14.RAM	00016	A00028	R4      VAR     WORD BANK0 SYSTEM       ' System Register
R4              		EQU	RAM_START + 008h
; C:\PROGRAM FILES (X86)\PBP3\PBPPIC14.RAM	00017	A0002A	R5      VAR     WORD BANK0 SYSTEM       ' System Register
R5              		EQU	RAM_START + 00Ah
; C:\PROGRAM FILES (X86)\PBP3\PBPPIC14.RAM	00018	A0002C	R6      VAR     WORD BANK0 SYSTEM       ' System Register
R6              		EQU	RAM_START + 00Ch
; C:\PROGRAM FILES (X86)\PBP3\PBPPIC14.RAM	00019	A0002E	R7      VAR     WORD BANK0 SYSTEM       ' System Register
R7              		EQU	RAM_START + 00Eh
; C:\PROGRAM FILES (X86)\PBP3\PBPPIC14.RAM	00020	A00030	R8      VAR     WORD BANK0 SYSTEM       ' System Register
R8              		EQU	RAM_START + 010h
; C:\PROGRAM FILES (X86)\PBP3\PBPPIC14.RAM	00026	A00032	FLAGS   VAR     BYTE BANK0 SYSTEM       ' Static flags
FLAGS           		EQU	RAM_START + 012h
; C:\PROGRAM FILES (X86)\PBP3\PBPPIC14.RAM	00025	A00033	GOP     VAR     BYTE BANK0 SYSTEM       ' Gen Op Parameter
GOP             		EQU	RAM_START + 013h
; C:\PROGRAM FILES (X86)\PBP3\PBPPIC14.RAM	00022	A00034	RM1     VAR     BYTE BANK0 SYSTEM       ' Pin 1 Mask
RM1             		EQU	RAM_START + 014h
; C:\PROGRAM FILES (X86)\PBP3\PBPPIC14.RAM	00024	A00035	RM2     VAR     BYTE BANK0 SYSTEM       ' Pin 2 Mask
RM2             		EQU	RAM_START + 015h
; C:\PROGRAM FILES (X86)\PBP3\PBPPIC14.RAM	00021	A00036	RR1     VAR     BYTE BANK0 SYSTEM       ' Pin 1 Register
RR1             		EQU	RAM_START + 016h
; C:\PROGRAM FILES (X86)\PBP3\PBPPIC14.RAM	00023	A00037	RR2     VAR     BYTE BANK0 SYSTEM       ' Pin 2 Register
RR2             		EQU	RAM_START + 017h
; U:\MECH 307 CODE\PROJECT\TURNSIGNALS\TURNSIGNAL.PBP	00001	A00038	#CONFIG
PB01            		EQU	RAM_START + 018h
; U:\MECH 307 CODE\PROJECT\TURNSIGNALS\TURNSIGNAL.PBP	00026	A00039	photo_value	Var	BYTE       'Value returned by POT command		
_photo_value     		EQU	RAM_START + 019h
; C:\PROGRAM FILES (X86)\PBP3\DEVICES\PIC16F88.PBPINC	00145	PORTL   VAR     PORTB
_PORTL           		EQU	 PORTB
; C:\PROGRAM FILES (X86)\PBP3\DEVICES\PIC16F88.PBPINC	00146	PORTH   VAR     PORTA
_PORTH           		EQU	 PORTA
; C:\PROGRAM FILES (X86)\PBP3\DEVICES\PIC16F88.PBPINC	00147	TRISL   VAR     TRISB
_TRISL           		EQU	 TRISB
; C:\PROGRAM FILES (X86)\PBP3\DEVICES\PIC16F88.PBPINC	00148	TRISH   VAR     TRISA
_TRISH           		EQU	 TRISA
#define _buttonR         	_PORTA??0
#define _ledR            	_PORTA??1
#define _buttonL         	_PORTA??3
#define _ledL            	_PORTA??2
#define _photo           	_PORTA??4
#define _ledTail         	_PORTB??0
#define _ledHead         	_PORTB??1
#define _buttonAuto      	_PORTB??6
#define _buttonOn        	_PORTB??7
#define _turnOnHeadAndTail	 PB01, 002h
#define _blinkLedL       	 PB01, 000h
#define _blinkLedR       	 PB01, 001h
#define _OSCCON??4       	 OSCCON, 004h
#define _OSCCON??5       	 OSCCON, 005h
#define _OSCCON??6       	 OSCCON, 006h
#define _PORTA??0        	 PORTA, 000h
#define _PORTA??1        	 PORTA, 001h
#define _PORTA??3        	 PORTA, 003h
#define _PORTA??2        	 PORTA, 002h
#define _PORTA??4        	 PORTA, 004h
#define _PORTB??0        	 PORTB, 000h
#define _PORTB??1        	 PORTB, 001h
#define _PORTB??6        	 PORTB, 006h
#define _PORTB??7        	 PORTB, 007h

; Constants.
_SCALE           		EQU	000FFh
	INCLUDE	"TURNSIGNAL.MAC"
	INCLUDE	"C:\PROGRAM FILES (X86)\PBP3\PBPPIC14.LIB"


; C:\PROGRAM FILES (X86)\PBP3\DEVICES\PIC16F88.PBPINC	00036	#HEADER
; C:\PROGRAM FILES (X86)\PBP3\DEVICES\PIC16F88.PBPINC	00060	#CONFIG
; C:\PROGRAM FILES (X86)\PBP3\DEVICES\PIC16F88.PBPINC	00134	BANK0   $0020, $007F
; C:\PROGRAM FILES (X86)\PBP3\DEVICES\PIC16F88.PBPINC	00135	BANK1   $00A0, $00EF
; C:\PROGRAM FILES (X86)\PBP3\DEVICES\PIC16F88.PBPINC	00136	BANK2   $0110, $016F
; C:\PROGRAM FILES (X86)\PBP3\DEVICES\PIC16F88.PBPINC	00137	BANK3   $0190, $01EF
; C:\PROGRAM FILES (X86)\PBP3\DEVICES\PIC16F88.PBPINC	00139	EEPROM  $2100, $21FF
; C:\PROGRAM FILES (X86)\PBP3\DEVICES\PIC16F88.PBPINC	00141	    #ERROR "-n option (PBPL) is not supported for this device."
; C:\PROGRAM FILES (X86)\PBP3\DEVICES\PIC16F88.PBPINC	00142	#ENDIF
; C:\PROGRAM FILES (X86)\PBP3\DEVICES\PIC16F88.PBPINC	00143	LIBRARY "PBPPIC14"
; C:\PROGRAM FILES (X86)\PBP3\DEVICES\PIC16F88.PBPINC	00144	DEFINE  CODE_SIZE 4

; C:\PROGRAM FILES (X86)\PBP3\DEVICES\PIC16F88.PBPINC	00149	include "PBPPIC14.RAM"
; C:\PROGRAM FILES (X86)\PBP3\DEVICES\PIC16F88.PBPINC	00153	#HEADER
; U:\MECH 307 CODE\PROJECT\TURNSIGNALS\TURNSIGNAL.PBP	00001	#CONFIG
; U:\MECH 307 CODE\PROJECT\TURNSIGNALS\TURNSIGNAL.PBP	00005	DEFINE OSC 8

; U:\MECH 307 CODE\PROJECT\TURNSIGNALS\TURNSIGNAL.PBP	00006	OSCCON.4 = 1
	MOVE?CT	001h, _OSCCON??4

; U:\MECH 307 CODE\PROJECT\TURNSIGNALS\TURNSIGNAL.PBP	00007	OSCCON.5 = 1
	MOVE?CT	001h, _OSCCON??5

; U:\MECH 307 CODE\PROJECT\TURNSIGNALS\TURNSIGNAL.PBP	00008	OSCCON.6 = 1
	MOVE?CT	001h, _OSCCON??6

; U:\MECH 307 CODE\PROJECT\TURNSIGNALS\TURNSIGNAL.PBP	00010	ANSEL=0     'Turn off the A/D converter
	MOVE?CB	000h, ANSEL
; U:\MECH 307 CODE\PROJECT\TURNSIGNALS\TURNSIGNAL.PBP	00025	SCALE		Con	255        'POT statement scale factor

; U:\MECH 307 CODE\PROJECT\TURNSIGNALS\TURNSIGNAL.PBP	00031	turnOnHeadAndTail = 0
	MOVE?CT	000h, _turnOnHeadAndTail

; U:\MECH 307 CODE\PROJECT\TURNSIGNALS\TURNSIGNAL.PBP	00033	blinkLedL = 0
	MOVE?CT	000h, _blinkLedL

; U:\MECH 307 CODE\PROJECT\TURNSIGNALS\TURNSIGNAL.PBP	00035	blinkLedR = 0
	MOVE?CT	000h, _blinkLedR

; U:\MECH 307 CODE\PROJECT\TURNSIGNALS\TURNSIGNAL.PBP	00038	TRISA=%01001				'Designate PORTA Pins as inputs and output
	MOVE?CB	009h, TRISA

; U:\MECH 307 CODE\PROJECT\TURNSIGNALS\TURNSIGNAL.PBP	00039	TRISB=%11000000				'Designate PORTB Pins as outputs
	MOVE?CB	0C0h, TRISB

; U:\MECH 307 CODE\PROJECT\TURNSIGNALS\TURNSIGNAL.PBP	00042	main:

	LABEL?L	_main	

; U:\MECH 307 CODE\PROJECT\TURNSIGNALS\TURNSIGNAL.PBP	00045	headlight:

	LABEL?L	_headlight	

; U:\MECH 307 CODE\PROJECT\TURNSIGNALS\TURNSIGNAL.PBP	00047	    if(buttonL == 1) then 
	CMPNE?TCL	_buttonL, 001h, L00001

; U:\MECH 307 CODE\PROJECT\TURNSIGNALS\TURNSIGNAL.PBP	00048	        high blinkLedL
	HIGH?T	_blinkLedL

; U:\MECH 307 CODE\PROJECT\TURNSIGNALS\TURNSIGNAL.PBP	00049	    else
	GOTO?L	L00002
	LABEL?L	L00001	

; U:\MECH 307 CODE\PROJECT\TURNSIGNALS\TURNSIGNAL.PBP	00050	        low blinkLedL
	LOW?T	_blinkLedL

; U:\MECH 307 CODE\PROJECT\TURNSIGNALS\TURNSIGNAL.PBP	00051	    endif
	LABEL?L	L00002	

; U:\MECH 307 CODE\PROJECT\TURNSIGNALS\TURNSIGNAL.PBP	00054	    if(buttonR == 1) then 
	CMPNE?TCL	_buttonR, 001h, L00003

; U:\MECH 307 CODE\PROJECT\TURNSIGNALS\TURNSIGNAL.PBP	00055	        high blinkLedR
	HIGH?T	_blinkLedR

; U:\MECH 307 CODE\PROJECT\TURNSIGNALS\TURNSIGNAL.PBP	00056	    else
	GOTO?L	L00004
	LABEL?L	L00003	

; U:\MECH 307 CODE\PROJECT\TURNSIGNALS\TURNSIGNAL.PBP	00057	        low blinkLedR
	LOW?T	_blinkLedR

; U:\MECH 307 CODE\PROJECT\TURNSIGNALS\TURNSIGNAL.PBP	00058	    endif
	LABEL?L	L00004	

; U:\MECH 307 CODE\PROJECT\TURNSIGNALS\TURNSIGNAL.PBP	00066	    if(blinkLedL == 1) then 
	CMPNE?TCL	_blinkLedL, 001h, L00005

; U:\MECH 307 CODE\PROJECT\TURNSIGNALS\TURNSIGNAL.PBP	00067	        high ledL
	HIGH?T	_ledL

; U:\MECH 307 CODE\PROJECT\TURNSIGNALS\TURNSIGNAL.PBP	00068	    else
	GOTO?L	L00006
	LABEL?L	L00005	

; U:\MECH 307 CODE\PROJECT\TURNSIGNALS\TURNSIGNAL.PBP	00069	        low ledL
	LOW?T	_ledL

; U:\MECH 307 CODE\PROJECT\TURNSIGNALS\TURNSIGNAL.PBP	00070	    endif
	LABEL?L	L00006	

; U:\MECH 307 CODE\PROJECT\TURNSIGNALS\TURNSIGNAL.PBP	00071	    if(blinkLedR == 1) then 
	CMPNE?TCL	_blinkLedR, 001h, L00007

; U:\MECH 307 CODE\PROJECT\TURNSIGNALS\TURNSIGNAL.PBP	00072	        high ledR
	HIGH?T	_ledR

; U:\MECH 307 CODE\PROJECT\TURNSIGNALS\TURNSIGNAL.PBP	00073	    else
	GOTO?L	L00008
	LABEL?L	L00007	

; U:\MECH 307 CODE\PROJECT\TURNSIGNALS\TURNSIGNAL.PBP	00074	        low ledR
	LOW?T	_ledR

; U:\MECH 307 CODE\PROJECT\TURNSIGNALS\TURNSIGNAL.PBP	00075	    endif
	LABEL?L	L00008	

; U:\MECH 307 CODE\PROJECT\TURNSIGNALS\TURNSIGNAL.PBP	00080	POT photo,SCALE,photo_value
	POT?TCB	_photo, _SCALE, _photo_value

; U:\MECH 307 CODE\PROJECT\TURNSIGNALS\TURNSIGNAL.PBP	00083	if(buttonOn == 1) then 
	CMPNE?TCL	_buttonOn, 001h, L00009

; U:\MECH 307 CODE\PROJECT\TURNSIGNALS\TURNSIGNAL.PBP	00084	    high turnOnHeadAndTail
	HIGH?T	_turnOnHeadAndTail

; U:\MECH 307 CODE\PROJECT\TURNSIGNALS\TURNSIGNAL.PBP	00085	else
	GOTO?L	L00010
	LABEL?L	L00009	

; U:\MECH 307 CODE\PROJECT\TURNSIGNALS\TURNSIGNAL.PBP	00086	    if(buttonAuto == 1) then 
	CMPNE?TCL	_buttonAuto, 001h, L00011

; U:\MECH 307 CODE\PROJECT\TURNSIGNALS\TURNSIGNAL.PBP	00087	        if (photo_value > 128) then 
	CMPLE?BCL	_photo_value, 080h, L00013

; U:\MECH 307 CODE\PROJECT\TURNSIGNALS\TURNSIGNAL.PBP	00088	            high turnOnHeadAndTail
	HIGH?T	_turnOnHeadAndTail

; U:\MECH 307 CODE\PROJECT\TURNSIGNALS\TURNSIGNAL.PBP	00089	        else
	GOTO?L	L00014
	LABEL?L	L00013	

; U:\MECH 307 CODE\PROJECT\TURNSIGNALS\TURNSIGNAL.PBP	00090	            low turnOnHeadAndTail
	LOW?T	_turnOnHeadAndTail

; U:\MECH 307 CODE\PROJECT\TURNSIGNALS\TURNSIGNAL.PBP	00091	        endif
	LABEL?L	L00014	

; U:\MECH 307 CODE\PROJECT\TURNSIGNALS\TURNSIGNAL.PBP	00092	    else
	GOTO?L	L00012
	LABEL?L	L00011	

; U:\MECH 307 CODE\PROJECT\TURNSIGNALS\TURNSIGNAL.PBP	00093	        low turnOnHeadAndTail
	LOW?T	_turnOnHeadAndTail

; U:\MECH 307 CODE\PROJECT\TURNSIGNALS\TURNSIGNAL.PBP	00094	    endif
	LABEL?L	L00012	

; U:\MECH 307 CODE\PROJECT\TURNSIGNALS\TURNSIGNAL.PBP	00095	endif
	LABEL?L	L00010	

; U:\MECH 307 CODE\PROJECT\TURNSIGNALS\TURNSIGNAL.PBP	00098	if (turnOnHeadAndTail == 1) then 
	CMPNE?TCL	_turnOnHeadAndTail, 001h, L00015

; U:\MECH 307 CODE\PROJECT\TURNSIGNALS\TURNSIGNAL.PBP	00099	    high ledHead
	HIGH?T	_ledHead

; U:\MECH 307 CODE\PROJECT\TURNSIGNALS\TURNSIGNAL.PBP	00100	    high ledTail
	HIGH?T	_ledTail

; U:\MECH 307 CODE\PROJECT\TURNSIGNALS\TURNSIGNAL.PBP	00101	else
	GOTO?L	L00016
	LABEL?L	L00015	

; U:\MECH 307 CODE\PROJECT\TURNSIGNALS\TURNSIGNAL.PBP	00102	    low ledHead
	LOW?T	_ledHead

; U:\MECH 307 CODE\PROJECT\TURNSIGNALS\TURNSIGNAL.PBP	00103	    low ledTail
	LOW?T	_ledTail

; U:\MECH 307 CODE\PROJECT\TURNSIGNALS\TURNSIGNAL.PBP	00104	endif
	LABEL?L	L00016	

; U:\MECH 307 CODE\PROJECT\TURNSIGNALS\TURNSIGNAL.PBP	00108	goto main
	GOTO?L	_main

; U:\MECH 307 CODE\PROJECT\TURNSIGNALS\TURNSIGNAL.PBP	00109	End
	END?	

	END
